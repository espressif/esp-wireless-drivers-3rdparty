## helper_project/sdkconfig.defaults
```kconfig
CONFIG_WPA_MBEDTLS_TLS_CLIENT=n
CONFIG_BT_ENABLED=y
CONFIG_WPA_DPP_SUPPORT=n
CONFIG_WPA_MBEDTLS_CRYPTO=n
CONFIG_ESP32_WIFI_ENABLE_WPA3_OWE_STA=n
```

## patch/esp32s2/sdkconfig.defaults
```kconfig
CONFIG_WPA_MBEDTLS_TLS_CLIENT=n
CONFIG_WPA_DPP_SUPPORT=n
CONFIG_WPA_MBEDTLS_CRYPTO=n
CONFIG_ESP32_WIFI_ENABLE_WPA3_OWE_STA=n
CONFIG_COMPILER_OPTIMIZATION_SIZE=y
```
